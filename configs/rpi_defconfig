## configs/rpi_defconfig
```kconfig
BR2_arm=y
BR2_arm1176jzf_s=y

BR2_CCACHE=y
BR2_OPTIMIZE_2=y

BR2_TOOLCHAIN_CTNG=y
BR2_TOOLCHAIN_CTNG_eglibc=y
BR2_TOOLCHAIN_CTNG_LIBC="eglibc"
BR2_TOOLCHAIN_CTNG_CONFIG="board/arm/rpi/crosstool-ng.config-eglibc"
BR2_TOOLCHAIN_CTNG_CXX=y
# BR2_TOOLCHAIN_CTNG_THREADS_PTHREADS is not set
BR2_TOOLCHAIN_CTNG_THREADS_NPTL=y

BR2_ENABLE_LOCALE_PURGE=y
BR2_ENABLE_LOCALE_WHITELIST="C en_US"

BR2_TARGET_GENERIC_HOSTNAME="rpi"
BR2_TARGET_GENERIC_ISSUE=""
BR2_TARGET_GENERIC_ROOT_PASSWD="root"
BR2_TARGET_GENERIC_GETTY_PORT="tty1"
BR2_TARGET_GENERIC_GETTY_TERM=""

BR2_TARGET_OPTIMIZATION="-pipe -mhard-float -mfloat-abi=hard -mfpu=vfp -mtune=arm1176jzf-s -march=armv6zk -fsigned-char -fomit-frame-pointer"

BR2_ROOTFS_DEVICE_CREATION_DYNAMIC_UDEV=y

BR2_PACKAGE_DROPBEAR=y
BR2_PACKAGE_DROPBEAR_DISABLE_REVERSEDNS=y

BR2_PACKAGE_UDEV=y
BR2_PACKAGE_UDEV_RULES_GEN=y

BR2_PACKAGE_RPI_FIRMWARE=y
BR2_PACKAGE_RPI_USERLAND=y
BR2_PACKAGE_LIBCOFI=y

BR2_PACKAGE_OPENSSL=y
BR2_PACKAGE_CA_CERTIFICATES=y

BR2_PACKAGE_GSTREAMER=y
BR2_PACKAGE_GSTREAMER_GST_DEBUG=y
BR2_PACKAGE_GSTREAMER_PLUGIN_REGISTRY=y

BR2_PACKAGE_GST_PLUGINS_BASE=y
BR2_PACKAGE_GST_PLUGINS_BASE_PLUGIN_APP=y
BR2_PACKAGE_GST_PLUGINS_BASE_PLUGIN_AUDIOCONVERT=y
BR2_PACKAGE_GST_PLUGINS_BASE_PLUGIN_AUDIORESAMPLE=y
BR2_PACKAGE_GST_PLUGINS_BASE_PLUGIN_AUDIOTESTSRC=y
BR2_PACKAGE_GST_PLUGINS_BASE_PLUGIN_FFMPEGCOLORSPACE=y
BR2_PACKAGE_GST_PLUGINS_BASE_PLUGIN_GDP=y
BR2_PACKAGE_GST_PLUGINS_BASE_PLUGIN_PLAYBACK=y
BR2_PACKAGE_GST_PLUGINS_BASE_PLUGIN_SUBPARSE=y
BR2_PACKAGE_GST_PLUGINS_BASE_PLUGIN_TCP=y
BR2_PACKAGE_GST_PLUGINS_BASE_PLUGIN_TYPEFIND=y
BR2_PACKAGE_GST_PLUGINS_BASE_PLUGIN_VIDEOTESTSRC=y
BR2_PACKAGE_GST_PLUGINS_BASE_PLUGIN_VIDEOSCALE=y
BR2_PACKAGE_GST_PLUGINS_BASE_PLUGIN_VOLUME=y
BR2_PACKAGE_GST_PLUGINS_BASE_PLUGIN_ALSA=y

BR2_PACKAGE_GST_PLUGINS_GOOD=y
BR2_PACKAGE_GST_PLUGINS_GOOD_BZ2=y
BR2_PACKAGE_GST_PLUGINS_GOOD_ZLIB=y
BR2_PACKAGE_GST_PLUGINS_GOOD_PLUGIN_AUDIOPARSERS=y
BR2_PACKAGE_GST_PLUGINS_GOOD_PLUGIN_AUTODETECT=y
BR2_PACKAGE_GST_PLUGINS_GOOD_PLUGIN_AVI=y
BR2_PACKAGE_GST_PLUGINS_GOOD_PLUGIN_FLV=y
BR2_PACKAGE_GST_PLUGINS_GOOD_PLUGIN_ID3DEMUX=y
BR2_PACKAGE_GST_PLUGINS_GOOD_PLUGIN_ICYDEMUX=y
BR2_PACKAGE_GST_PLUGINS_GOOD_PLUGIN_ISOMP4=y
BR2_PACKAGE_GST_PLUGINS_GOOD_PLUGIN_MATROSKA=y
BR2_PACKAGE_GST_PLUGINS_GOOD_PLUGIN_WAVPARSE=y
BR2_PACKAGE_GST_PLUGINS_GOOD_PLUGIN_SOUPHTTPSRC=y

BR2_PACKAGE_GST_PLUGINS_BAD=y
BR2_PACKAGE_GST_PLUGINS_BAD_PLUGIN_HLS=y
BR2_PACKAGE_GST_PLUGINS_BAD_PLUGIN_MPEGDEMUX=y
BR2_PACKAGE_GST_PLUGINS_BAD_PLUGIN_MPEGTSDEMUX=y
BR2_PACKAGE_GST_PLUGINS_BAD_PLUGIN_VIDEOPARSERS=y

# BR2_PACKAGE_ALSA_LIB_ALOAD is not set
# BR2_PACKAGE_ALSA_LIB_RAWMIDI is not set
# BR2_PACKAGE_ALSA_LIB_HWDEP is not set
# BR2_PACKAGE_ALSA_LIB_SEQ is not set
# BR2_PACKAGE_ALSA_LIB_ALISP is not set
# BR2_PACKAGE_ALSA_LIB_OLD_SYMBOLS is not set

BR2_PACKAGE_GST_OMX=y

BR2_PACKAGE_GST_FLUDASH=y

BR2_PACKAGE_LIBSOUP_SSL=y

BR2_PACKAGE_QT5=y
BR2_PACKAGE_QT5WEBKIT=y
BR2_PACKAGE_QT5BASE_EGLFS=y
BR2_PACKAGE_QT5BASE_CONCURRENT=y
BR2_PACKAGE_QT5BASE_TEST=y
BR2_PACKAGE_QT5BASE_SQL=y
BR2_PACKAGE_QT5BASE_XML=y
BR2_PACKAGE_QT5BASE_WIDGETS=y
BR2_PACKAGE_QT5BASE_PRINTSUPPORT=y
BR2_PACKAGE_QT5BASE_FONTCONFIG=y
BR2_PACKAGE_QT5BASE_GIF=y
BR2_PACKAGE_QT5BASE_JPEG=y
BR2_PACKAGE_QT5BASE_PNG=y
BR2_PACKAGE_QT5BASE_LICENSE_APPROVED=y

BR2_PACKAGE_ICU_MINIMIZED=y

BR2_PACKAGE_MLBROWSER=y

BR2_PACKAGE_LIBCEC_UINPUT=y
BR2_PACKAGE_BOOST_PROGRAM_OPTIONS=y

BR2_PACKAGE_F2FS_TOOLS=y

BR2_LINUX_KERNEL=y
BR2_LINUX_KERNEL_CUSTOM_TARBALL=y
BR2_LINUX_KERNEL_CUSTOM_TARBALL_LOCATION="https://github.com/raspberrypi/linux/tarball/rpi-3.9.y/56ec798cbe7d695816021a5ebc10cb2b42213b56.tar.gz"
BR2_LINUX_KERNEL_USE_CUSTOM_CONFIG=y
BR2_LINUX_KERNEL_CUSTOM_CONFIG_FILE="board/arm/rpi/linux.config"
BR2_LINUX_KERNEL_ZIMAGE=y
```

## package/ca-certificates/Config.in
```kconfig
config BR2_PACKAGE_CA_CERTIFICATES
	bool "ca-certificates"
	help
	  Generate CA certificates
```

## package/icu/Config.in
```kconfig
config BR2_PACKAGE_ICU
	bool "icu"
	depends on BR2_INSTALL_LIBSTDCPP
	depends on BR2_USE_WCHAR
	help
	  International Components for Unicode.

	  http://site.icu-project.org/

config BR2_PACKAGE_ICU_MINIMIZED
	bool "minimized"
	depends on BR2_PACKAGE_ICU
	help
	  Uses a minimized icu data set.

comment "icu requires a toolchain with C++ support and WCHAR enabled"
	depends on !BR2_INSTALL_LIBSTDCPP || !BR2_USE_WCHAR
```

## package/libcec-uinput/Config.in
```kconfig
config BR2_PACKAGE_LIBCEC_UINPUT
	select BR2_PACKAGE_LIBCEC
	select BR2_PACKAGE_LIBCEC_RPI
	select BR2_PACKAGE_BOOST
	select BR2_PACKAGE_BOOST_PROGRAM_OPTIONS
	select BR2_PACKAGE_LOG4CPLUS
	bool "libcec-uinput"
	help
	  libcec uinput deamon.
```

## package/libcec/Config.in
```kconfig
config BR2_PACKAGE_LIBCEC
	select BR2_PACKAGE_LOCKDEV
	bool "libcec"
	help
		hdmi cec library.

		 https://github.com/Pulse-Eight/libcec

config BR2_PACKAGE_LIBCEC_RPI
	bool "libcec-rpi"
	depends on BR2_PACKAGE_LIBCEC
	depends on BR2_PACKAGE_RPI_USERLAND
	default y
```

## package/log4cplus/Config.in
```kconfig
config BR2_PACKAGE_LOG4CPLUS
	bool "log4cplus"
	help
	  C++ port for Log for Java (log4j)
```

## package/mlbrowser/Config.in
```kconfig
config BR2_PACKAGE_MLBROWSER
	bool "mlbrowser"
	depends on BR2_PACKAGE_QT_WEBKIT

	help
		Metrological's simple (accellerated) browser implementation
		http://www.metrological.com
		m.sieben@metrological.com

comment "mlbrowser was developed for Qt4 QWS with WebKit"
	depends on !BR2_PACKAGE_QT_WEBKIT
```

## package/multimedia/gst-fludash/Config.in
```kconfig
config BR2_PACKAGE_GST_FLUDASH
	bool "gst-fludash"
	depends on BR2_PACKAGE_GSTREAMER
	depends on BR2_PACKAGE_RPI_USERLAND
	select BR2_PACKAGE_GST_PLUGINS_BASE
	select BR2_PACKAGE_LIBCURL
	help
	  GStreamer DASH plug-in.

	  http://www.metrological.com
```

## package/qt5/qt5wayland/Config.in
```kconfig
config BR2_PACKAGE_QT5WAYLAND
	bool "qt5wayland"
	select BR2_PACKAGE_QTDECLARATIVE
	select BR2_PACKAGE_WAYLAND
	help
		Qt 5 Wayland module
```

## package/qt5/qt5wktst/Config.in
```kconfig
config BR2_PACKAGE_QT5WKTST
	bool "qt5wktst"
	depends on BR2_PACKAGE_QT5WEBKIT
	help
	  Qt is a cross-platform application and UI framework for
	  developers using C++.

	  This package corresponds to the qt5webkit test module.
```

## package/snowshoe/Config.in
```kconfig
config BR2_PACKAGE_SNOWSHOE
	bool "snowshoe"
	depends on BR2_PACKAGE_QT5WEBKIT

	help
		http://snowshoe.openbossa.org

comment "SnowShoe is a Qt5 WebKit2 browser"
	depends on !BR2_PACKAGE_QT5WEBKIT
```
